#include "ADC.h"

void ADC3_Init(void)
{
	/*
		设置为 ADC 单通道，光敏电阻对应 PF8 引脚，对应 ADC3_IN6 通道
		
		时钟使能 ：GPIOF、ADC3
		GPIO 引脚配置：PF8 引脚设置为模拟输入模式
		ADC 接收配置：时钟、通道、Tconv、数据对齐
		ADC 自校准
		ADC 使能开启
	*/

	// 使能 GPIOF
	RCC -> APB2ENR |= (0x1 << 7); 
	// 使能 ADC
	RCC -> APB2ENR |= (0x1 << 15);
	// 配置 ADC 时钟分频
	RCC -> CFGR &= ~(0x3 << 14);// 清零
	RCC -> CFGR |= (0x2 << 14);// 配置为 6 分频，ADC 实际频率为 12MHz （ADC 最大为 14MHz）
	// 配置引脚为 模拟输入
	GPIOF -> CRH &= ~(0xf << 0);
	GPIOF -> CRH |= (0x0 << 0);
	
	// ADC 模块中，选择规则序列，使用通道数量为：一个
	ADC3 -> SQR1 &= ~(0xf << 20);// 复位为 0 ，直接写入目标值 0x0 即可
	
	// 开启现在已经申请的第一个通道，将其与 第六个（即 ADC3_IN6）连接
	ADC3 -> SQR3 &= ~(0x1f << 0);// 清零该位
	ADC3 -> SQR3 |= (0x6 << 0);// 开启通道
	
	/*	
		Tconv 是 Total Conversion Time 的缩写，中文意为 总转换时间
		设置采样时间，Tconv = 采样时间+12.5个周期/ADCCLK  
		这里选择采样时间=239.5
	*/ 
	ADC3 -> SMPR2 |= (0x7 << 18);
	
//	// 设置为 独立模式，该四位在 ADC2 和 ADC3 中为保留位，实际上不需要配置，即使需要配置，其复位值为 0x0，默认独立模式
//	ADC3->CR1 |= (0x0 << 16);
//	// 打开扫描模式
//	ADC3->CR1 |= (0x1 << 8);
	// 当前仅单通道，即只配置了一个通道，所以扫描模式开不开无所谓
	ADC3 -> CR1 &= ~(0x1 << 8);
	
	// 配置 ADC 触发方式：设置为外部事件触发，触发事件选择为 SWSTART （开始转换规则通道）
	ADC3 -> CR2 |= (0x1 << 20); // 外部事件触发
	ADC3 -> CR2 |= (0x7 << 17); // 选择触发事件为 SWSTART
//	ADC3 -> CR2 |= (0x1 << 22); // 打开 SWSTART （开始转换规则通道）
	
	// 配置数据格式：设置为右对齐，选择连续转换模式，持续转换数据
	ADC3 -> CR2 &= ~(0x1 << 11); // 右对齐模式
	ADC3 -> CR2 |= (0x1 << 1); // 连续转换模式
	
	
	// 校准 ADC
	ADC3 -> CR2 &= ~(0x1 << 0);// 关闭，并进入断电模式
	Delay_ms(10);// 等待断电完成
	
	ADC3 -> CR2 |= (0x1 << 0);// 打开 ADC 转换/校准
	Delay_ms(1);// 等待启动
	
	ADC3 -> CR2 |= (0x1 << 3);// 复位初始化校准寄存器
	while((ADC3 -> CR2 & (0x1 << 3)));// 等待校准寄存器初始化
	
	ADC3 -> CR2 |= (0x1 << 2); // 开始校准
	while((ADC3 -> CR2 &(0x1 << 2))); // 等待校准结束
	
	// 使能 ADC 
	ADC3 -> CR2 |= (0x1 << 0);// 使能启动 ADC
	ADC3 -> CR2 |= (0x1 << 22); // 打开 SWSTART （开始转换规则通道）
}

uint16_t Light_GetData(void)
{
	while((ADC3->SR & (0x1 << 1)) == 0);//转换完成
	return ADC3->DR;
}

